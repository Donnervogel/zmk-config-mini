
/{
    chosen {
        zmk,kscan = &default_kscan;
    };

    default_kscan: kscan {
        compatible = "zmk,kscan-gpio-direct";
        label = "default_kscan";

        input-gpios = <&gpio0 1  (GPIO_ACTIVE_HIGH | GPIO_PULL_DOWN)>;
    };

    
};
